## test/fixture/Kconfig
```kconfig
mainmenu "Demo Project"

config MODULES
    bool "Enable loadable module support"
    option modules
    default y

config APP
    bool "Enable application"
    default y
    help
      Master switch for the demo application.

menu "Drivers"
    depends on APP

source "drivers/Kconfig"

endmenu

source "lib/Kconfig"
```

## test/fixture/drivers/Kconfig
```kconfig
config DRIVER
    bool "Demo driver"
    default y
    help
      A demo driver that requires APP.

config DRIVER_LEVEL
    int "Driver level"
    range 1 5
    default 3
```

## test/fixture/extra/Kconfig
```kconfig
config EXTRA
    tristate "Extra feature"
    default m
    help
      Discovered but never sourced by the root Kconfig.
```

## test/fixture/lib/Kconfig
```kconfig
config LIB_NAME
    string "Library name"
    default "demo"

config LIB_DEBUG
    bool "Library debug"
    depends on APP
```
